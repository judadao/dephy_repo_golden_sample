## CMakeLists.txt
```
cmake_minimum_required(VERSION 3.20.0)

find_package(Zephyr REQUIRED HINTS $ENV{ZEPHYR_BASE})
project(dephy_repo_golden_sample)

target_sources(app PRIVATE
  src/main.c
)
```

## prj.conf
```kconfig
# Product app owns main().

CONFIG_LOG=y
CONFIG_LOG_DEFAULT_LEVEL=3
CONFIG_PRINTK=y

# Example module dependencies. Disable or tune these per product.
CONFIG_MQTT_MIN_BROKER=y
CONFIG_MQTT_STANDALONE=n
CONFIG_MQTT_MAX_CLIENTS=4
CONFIG_MQTT_P2P_DYNAMIC=y
CONFIG_MQTT_P2P_STATIC_SEEDS_ONLY=y
CONFIG_MQTT_P2P_PEER_MAX=4
CONFIG_MQTT_P2P_REMOTE_SUBS_PER_NODE=4
CONFIG_MQTT_P2P_SHARD_OWNER_CACHE_SIZE=64
CONFIG_MODBUS_ZEPHYR_ESP32=y

# Minimal networking baseline for MQTT-capable products.
CONFIG_NETWORKING=y
CONFIG_NET_TCP=y
CONFIG_NET_SOCKETS=y
CONFIG_NET_IPV4=y
CONFIG_NET_IPV6=n
CONFIG_WIFI=y
CONFIG_NET_L2_WIFI_MGMT=y
CONFIG_NET_DHCPV4=y

# ESP32 memory baseline; tune per product.
CONFIG_HEAP_MEM_POOL_SIZE=24576
CONFIG_MAIN_STACK_SIZE=2048
CONFIG_SYSTEM_WORKQUEUE_STACK_SIZE=1536
```

## src/main.c
```c
#include <zephyr/kernel.h>
#include <zephyr/logging/log.h>

LOG_MODULE_REGISTER(golden_sample, LOG_LEVEL_INF);

int main(void)
{
    LOG_INF("Dephy product golden sample starting");
    LOG_INF("Dephy product golden sample ready");
    return 0;
}
```
